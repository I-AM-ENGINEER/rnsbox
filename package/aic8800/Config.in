## package/aic8800/Config.in
```kconfig
config BR2_PACKAGE_AIC8800
	bool "aic8800 (AIC8800D80 SDIO WiFi/BT)"
	depends on BR2_LINUX_KERNEL
	select BR2_PACKAGE_AIC8800_SDIO_FIRMWARE
	help
	  Out-of-tree AIC8800D80 SDIO WiFi + Bluetooth driver for the Sophgo
	  SG2000/SG2002 boards (Duo Module 01, Duo S, LicheeRV Nano). The
	  modules land in /root/, where /root/wifi.sh loads them after the
	  LPO + WL_REG_ON chip-reset sequence S35wifi runs at boot.

	  Not needed on boards without the radio (CV1800B, Duo 256M, MT7628).

comment "aic8800 needs a Linux kernel to be built"
	depends on !BR2_LINUX_KERNEL
```

## package/ht-hd01-firmware/Config.in
```kconfig
config BR2_PACKAGE_HT_HD01_FIRMWARE
	bool "HT-HD01-V2 firmware blobs"
	help
	  Vendor firmware for the HT-HD01-V2: the MM6108 HaLow image and
	  the HD01_v2 board configuration, plus the MT7628 2.4 GHz WMAC
	  firmware.  These are proprietary blobs; they are installed for
	  local device operation only.
```

## package/morse-driver/Config.in
```kconfig
config BR2_PACKAGE_MORSE_DRIVER
	bool "morse-driver (MM6108 HaLow)"
	depends on BR2_LINUX_KERNEL
	help
	  Morse Micro MM6108 HaLow driver.  Linux 7.3 only carries the
	  newer MM8108 driver, so the MM6108 needs this out-of-tree module.

	  https://github.com/MorseMicro/morse_driver

comment "morse-driver needs a Linux kernel to be built"
	depends on !BR2_LINUX_KERNEL
```

## package/mt7628-esw/Config.in
```kconfig
config BR2_PACKAGE_MT7628_ESW
	bool "mt7628-esw (built-in switch init)"
	depends on BR2_LINUX_KERNEL
	help
	  Minimal platform driver that initialises the MT7628 built-in
	  Ethernet switch the way OpenWrt's esw_rt3050 driver does: VLAN 0
	  flat, all present ports untagged, CPU port a member.  Without it
	  mainline receives broadcast/multicast from the switch but not
	  unicast (ARP replies never reach the CPU).

comment "mt7628-esw needs a Linux kernel to be built"
	depends on !BR2_LINUX_KERNEL
```

## package/python-ble-reticulum/Config.in
```kconfig
config BR2_PACKAGE_PYTHON_BLE_RETICULUM
	bool "python-ble-reticulum"
	depends on BR2_PACKAGE_BLUEZ5_UTILS # D-Bus Bluetooth API (bluetoothd)
	depends on BR2_PACKAGE_DBUS         # system bus for BlueZ
	select BR2_PACKAGE_PYTHON_BLEAK     # central mode (scan + connect)
	select BR2_PACKAGE_RNSBOX_PYTHON_BLUEZERO # peripheral mode (GATT server)
	select BR2_PACKAGE_DBUS_PYTHON      # bluezero + the pairing agent
	help
	  Bluetooth Low Energy (BLE) interface for Reticulum, based on
	  https://github.com/torlando-tech/ble-reticulum (MIT).

	  Ships the upstream classes as the site-packages package
	  ble_reticulum plus the /etc/reticulum/interfaces/BLEInterface.py
	  shim that rnsd exec()s to instantiate `[[BLE Interface]]` stanzas.

	  Auto-discovers nearby Reticulum BLE peers (central mode via
	  bleak) and accepts inbound connections (peripheral mode via
	  bluezero/BlueZ GATT). Degrades to a logged no-op when no
	  Bluetooth adapter is present (USB dongle boards) and starts by
	  itself once a stack appears.

	  Needs BlueZ with experimental features enabled (the RNSBox
	  /etc/default/bluetoothd ships -E) and dbus-daemon running.

	  https://github.com/torlando-tech/ble-reticulum

comment "python-ble-reticulum needs BlueZ and D-Bus"
	depends on !BR2_PACKAGE_BLUEZ5_UTILS || !BR2_PACKAGE_DBUS
```

## package/python-bluezero/Config.in
```kconfig
config BR2_PACKAGE_PYTHON_BLUEZERO
	bool "python-bluezero"
	select BR2_PACKAGE_PYTHON_DBUS # runtime (module-level `import dbus`)
	help
	  A Python library for Bluetooth Low Energy (BLE) peripheral mode
	  on Linux: registers GATT applications and LE advertisements
	  with BlueZ over D-Bus.

	  Used by ble-reticulum's GATT server (BLE peripheral mode - other
	  Reticulum nodes and phone clients connect INBOUND over it).

	  https://ukBaz.github.io/bluezero/
```

## package/python-cryptography-legacy/Config.in
```kconfig
config BR2_PACKAGE_PYTHON_CRYPTOGRAPHY_LEGACY
	bool "python-cryptography (C/OpenSSL, no Rust)"
	depends on BR2_PACKAGE_PYTHON3
	select BR2_PACKAGE_PYTHON_CFFI
	select BR2_PACKAGE_PYTHON_SIX
	select BR2_PACKAGE_OPENSSL
	help
	  cryptography 3.3.2, the last C/OpenSSL release before the Rust
	  rewrite (3.4).  Buildroot's current python-cryptography uses
	  maturin/Rust, which has no MIPS cross target, so mipsel boards
	  would otherwise fall back to RNS's pure-Python AES/Ed25519/X25519.

	  This package installs the same "cryptography" Python module.
	  RNS's Provider detects it (>= 2.8) and uses OpenSSL for AES,
	  X25519 and Ed25519 instead of the pure-Python fallback.
```

## package/python-dbus/Config.in
```kconfig
config BR2_PACKAGE_PYTHON_DBUS
	bool "python-dbus"
	depends on BR2_PACKAGE_DBUS      # libdbus-1 + the system bus daemon
	depends on BR2_PACKAGE_LIBGLIB2  # _dbus_glib_bindings (GLib main loop)
	help
	  D-Bus Python bindings (the upstream dbus-python project): the
	  `dbus` module plus the `_dbus_bindings` and `_dbus_glib_bindings`
	  C extensions (GLib main-loop integration lives in
	  dbus.mainloop.glib).

	  Needed by python-bluezero (BLE peripheral mode) and
	  ble-reticulum's pairing agent (BLEAgent). Not selectable on its
	  own from the RNSBox menu - it is pulled in by those.

	  http://www.freedesktop.org/wiki/Software/DBusBindings

comment "python-dbus needs dbus and libglib2"
	depends on !BR2_PACKAGE_DBUS || !BR2_PACKAGE_LIBGLIB2
```

## package/python-lxmf/Config.in
```kconfig
config BR2_PACKAGE_PYTHON_LXMF
	bool "python-lxmf"
	select BR2_PACKAGE_PYTHON_RNS  # runtime
	help
	  LXMF (Lightweight eXtensible Message Format) — the
	  message-passing layer that nomadnet, Sideband, MeshChat
	  and other Reticulum-based apps share. Provides delivery,
	  storage, propagation and addressing for ~secure msg routes
	  across the Reticulum mesh.

	  https://github.com/markqvist/LXMF
```

## package/python-nomadnet/Config.in
```kconfig
config BR2_PACKAGE_PYTHON_NOMADNET
	bool "python-nomadnet"
	select BR2_PACKAGE_PYTHON_RNS         # runtime
	select BR2_PACKAGE_PYTHON_LXMF        # runtime
	select BR2_PACKAGE_PYTHON_URWID       # runtime (TUI)
	select BR2_PACKAGE_PYTHON_QRCODE      # runtime (QR identity codes)
	help
	  Nomad Network — a Reticulum-based application stack that
	  ships an LXMF propagation node, a nomadnet "page" server
	  (gopher-like browsable content over Reticulum), and a
	  terminal UI client. Installed here primarily so users can
	  host nomadnet pages from the device; the init script
	  S83nomadnet is shipped disabled by default and gated on a
	  flag in /etc/rnsbox/nomadnet.conf.

	  https://github.com/markqvist/NomadNet
```

## package/python-rns-time/Config.in
```kconfig
config BR2_PACKAGE_PYTHON_RNS_TIME
	bool "python-rns-time"
	select BR2_PACKAGE_PYTHON_RNS  # runtime
	help
	  rns-time — authenticated time over Reticulum.

	  The server asks ordinary NTP servers for the time and serves the
	  corrected time over Reticulum protocol v1 (app "rnstime", aspect
	  "time"). It needs no chrony, no GPS and no root: the measured
	  offset is added to the timestamps it hands out, so a host whose
	  own clock is wrong still serves correct time. It runs next to
	  rnsd through the shared instance.

	  The client measures time and --apply is used by
	  /etc/init.d/S88rnstime to set the box clock from a mesh time
	  server when ordinary NTP is unreachable. MeshAPI clients can
	  also use the "now" op.

	  https://github.com/wdunn001/rns-time
```

## package/rnsbox-bt-firmware/Config.in
```kconfig
config BR2_PACKAGE_RNSBOX_BT_FIRMWARE
	bool "rnsbox-bt-firmware"
	help
	  Broadcom Bluetooth firmware patches (BCM43430A1/BCM4345C0/
	  BCM4345C5 .hcd) for the Raspberry Pi onboard BT controllers,
	  from RPi-Distro/bluez-firmware at a pinned commit. Needed by
	  every Pi the universal image boots: Zero 2 W / Zero W / 3B /
	  3B+ / 3A+ / CM3 / 4B / 400 / CM4 / CM4S / 5. Proprietary blobs.

	  USB BLE dongles whose chip self-hosts its firmware (CSR8510)
	  need nothing; chipsets with host-side firmware (Realtek,
	  MediaTek, Intel) would need the matching linux-firmware files -
	  not shipped here yet.
```

## package/rnsbox-portal/Config.in
```kconfig
config BR2_PACKAGE_RNSBOX_PORTAL
	bool "rnsbox-portal"
	select BR2_PACKAGE_OPENSSL
	select BR2_PACKAGE_UHTTPD
	help
	  OpenWrt-style admin web UI for the RNSBox router build.

	  A single C++/CGI binary served per-request by uhttpd
	  (OpenWrt's tiny HTTP server; the web tier keeps ~0 resident
	  RAM since uhttpd forks the CGI per request), replacing the
	  former Flask app. No Python is needed for the web tier.

	  uhttpd is used instead of busybox httpd because it serves the
	  docroot index at bare "/" (busybox httpd 404s "/"), does
	  proper redirects/error pages, and can add TLS later.

	  Features:
	    - Dashboard: system + Reticulum status at a glance
	    - Network: WAN/LAN status, dnsmasq leases, port forwards
	      (WAN -> LAN DNAT), WAN-side open ports (input ACCEPT)
	    - Reticulum: live rnsd status, raw config editor, restart
	    - Settings: admin password + hostname

	  Stores port-forward / open-port / auth state under
	  /etc/rnsbox/ and regenerates /etc/nftables.conf via
	  rnsbox_portal.nftgen (called by /etc/init.d/S60routing).

	  Pure-Python; no Go/Node toolchain needed. Source is local.
```

## package/rnsbox-python-bluezero/Config.in
```kconfig
config BR2_PACKAGE_RNSBOX_PYTHON_BLUEZERO
	bool "rnsbox-python-bluezero"
	select BR2_PACKAGE_DBUS_PYTHON # runtime (module-level `import dbus`)
	help
	  A Python library for Bluetooth Low Energy (BLE) peripheral mode
	  on Linux: registers GATT applications and LE advertisements
	  with BlueZ over D-Bus. Used by ble-reticulum's GATT server
	  (BLE peripheral mode - other Reticulum nodes and phone clients
	  connect INBOUND over it).

	  This is buildroot's python-bluezero 0.9.1 (same sdist, same
	  version) packaged under a separate symbol on purpose: the
	  in-tree python-bluezero pulls python-gobject, whose
	  gobject-introspection dependency needs a glibc toolchain - the
	  RNSBox Raspberry Pi image is musl. bluezero itself is
	  pure Python and only needs dbus-python (dbus.mainloop.glib
	  comes from dbus-python, not PyGObject).

	  https://ukBaz.github.io/bluezero/
```

## package/rnsbox-update/Config.in
```kconfig
config BR2_PACKAGE_RNSBOX_UPDATE
	bool "rnsbox-update"
	select BR2_PACKAGE_PYTHON3
	select BR2_PACKAGE_XZ
	select BR2_PACKAGE_CA_CERTIFICATES
	help
	  RNSBox A/B whole-OS update agent: checks a user-configured
	  repository (GitHub Releases or any HTTP(S) manifest) on a random
	  7-14 day schedule, verifies sha256, writes the idle rootfs slot
	  and flips the A/B pointer with boot-count rollback.

	  https://github.com/I-AM-ENGINEER/rnsbox
```
