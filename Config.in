## board/sg2002-mainline/boot.its
```
/*
 * RNSBox mainline boot.sd FIT for the LicheeRV Nano (SG2002, C906).
 * Same scheme as board/sg2000-mainline/boot.its: the vendor u-boot boots
 * the FIT's default configuration (older generations append
 * #config-sg2002_licheervnano_sd), Image.gz is gunzipped to 0x80200000.
 *
 * NOTE: scaffold. Not wired into build.sh yet; the mainline v7.3-rc7 tree
 * already ships arch/riscv/boot/dts/sophgo/sg2002-licheerv-nano-b.dts.
 */
/dts-v1/;

/ {
	description = "RNSBox mainline (sg2002 licheerv-nano)";
	#address-cells = <2>;

	images {
		kernel-1 {
			description = "mainline linux Image.gz";
			data = /incbin/("./Image.gz");
			type = "kernel";
			arch = "riscv";
			os = "linux";
			compression = "gzip";
			load = <0x0 0x80200000>;
			entry = <0x0 0x80200000>;
			hash-1 {
				algo = "crc32";
			};
		};

		fdt-sg2002_licheervnano_sd {
			description = "mainline sg2002-licheerv-nano-b device tree";
			data = /incbin/("./sg2002-licheerv-nano-b.dtb");
			type = "flat_dt";
			arch = "riscv";
			compression = "none";
			hash-1 {
				algo = "crc32";
			};
		};
	};

	configurations {
		default = "config-sg2002_licheervnano_sd";
		config-sg2002_licheervnano_sd {
			description = "RNSBox mainline sg2002 (vendor u-boot name)";
			kernel = "kernel-1";
			fdt = "fdt-sg2002_licheervnano_sd";
		};
	};
};
```

## board/sg2002/boot.its
```
/*
 * RNSBox boot.sd FIT for the LicheeRV Nano (SG2002, C906).
 * Same scheme as board/sg2000/boot.its: the vendor u-boot boots
 * the FIT's default configuration (older generations append
 * #config-sg2002_licheervnano_sd), Image.gz is gunzipped to 0x80200000.
 *
 * Built by configs/rnsbox_licheerv_nano_defconfig; the
 * v7.3-rc7 tree already ships sg2002-licheerv-nano-b.dts and
 * linux-patches/0001-* enables its gmac0 + mdio nodes (internal EPHY).
 */
/dts-v1/;

/ {
	description = "RNSBox (sg2002 licheerv-nano)";
	#address-cells = <2>;

	images {
		kernel-1 {
			description = "linux Image.gz";
			data = /incbin/("./Image.gz");
			type = "kernel";
			arch = "riscv";
			os = "linux";
			compression = "gzip";
			load = <0x0 0x80200000>;
			entry = <0x0 0x80200000>;
			hash-1 {
				algo = "crc32";
			};
		};

		fdt-sg2002_licheervnano_sd {
			description = "sg2002-licheerv-nano-b device tree";
			data = /incbin/("./sg2002-licheerv-nano-b.dtb");
			type = "flat_dt";
			arch = "riscv";
			compression = "none";
			hash-1 {
				algo = "crc32";
			};
		};
	};

	configurations {
		default = "config-sg2002_licheervnano_sd";
		config-sg2002_licheervnano_sd {
			description = "RNSBox sg2002 (vendor u-boot name)";
			kernel = "kernel-1";
			fdt = "fdt-sg2002_licheervnano_sd";
		};
	};
};
```

## configs/rnsbox_duo256m_mainline_defconfig
```kconfig
# RNSBox Milk-V Duo 256M (Sophgo, C906 rv64gc) — MAINLINE 7.3 flow.
No WiFi/Ethernet; SD rootfs and USB CDC-NCM gadget.

BR2_riscv=y
# rv64gc (C906; Bootlin toolchain + rust riscv64gc target require C)
BR2_RISCV_ISA_RVC=y
BR2_TOOLCHAIN_EXTERNAL=y
BR2_TOOLCHAIN_EXTERNAL_BOOTLIN_RISCV64_LP64D_GLIBC_STABLE=y
BR2_JLEVEL=3
BR2_TARGET_GENERIC_HOSTNAME="rnsbox"
BR2_TARGET_GENERIC_ISSUE="RNSBox - Reticulum router (Milk-V Duo 256M, mainline)"
BR2_ROOTFS_DEVICE_TABLE="system/device_table_dev.txt system/device_table.txt"
BR2_TARGET_GENERIC_ROOT_PASSWD="admin"
# Shared SoC-independent RNSBox overlay first, SG2002-specific bits last
# (the later overlay wins: tuned fstab + zram/fstrim policy).
BR2_ROOTFS_OVERLAY="$(BR2_EXTERNAL_RNSBOX_PATH)/board/sg2000-mainline/rootfs-overlay $(BR2_EXTERNAL_RNSBOX_PATH)/board/sg2002-duo256m-mainline/rootfs-overlay"
BR2_ROOTFS_POST_BUILD_SCRIPT="$(BR2_EXTERNAL_RNSBOX_PATH)/board/common/slim-target.sh"
BR2_ROOTFS_POST_IMAGE_SCRIPT="$(BR2_EXTERNAL_RNSBOX_PATH)/board/sg2002-duo256m-mainline/post-image.sh"
BR2_LINUX_KERNEL=y
BR2_LINUX_KERNEL_CUSTOM_GIT=y
BR2_LINUX_KERNEL_CUSTOM_REPO_URL="https://git.kernel.org/pub/scm/linux/kernel/git/stable/linux.git"
BR2_LINUX_KERNEL_CUSTOM_REPO_VERSION="v7.3-rc7"
BR2_LINUX_KERNEL_PATCH="$(BR2_EXTERNAL_RNSBOX_PATH)/board/sg2002-duo256m-mainline/linux-patches"
BR2_LINUX_KERNEL_USE_CUSTOM_CONFIG=y
BR2_LINUX_KERNEL_CUSTOM_CONFIG_FILE="$(BR2_EXTERNAL_RNSBOX_PATH)/board/sg2002-duo256m-mainline/linux.config"
BR2_LINUX_KERNEL_DTS_SUPPORT=y
BR2_LINUX_KERNEL_INTREE_DTS_NAME="sophgo/sg2002-milkv-duo256m"
BR2_LINUX_KERNEL_NEEDS_HOST_OPENSSL=y
BR2_PACKAGE_BUSYBOX_CONFIG_FRAGMENT_FILES="$(BR2_EXTERNAL_RNSBOX_PATH)/board/sg2000-mainline/busybox.fragment"
BR2_PACKAGE_BUSYBOX_SHOW_OTHERS=y
BR2_PACKAGE_XZ=y
BR2_PACKAGE_DOSFSTOOLS=y
BR2_PACKAGE_DOSFSTOOLS_FSCK_FAT=y
BR2_PACKAGE_DOSFSTOOLS_MKFS_FAT=y
BR2_PACKAGE_E2FSPROGS=y
BR2_PACKAGE_PYTHON3=y
BR2_PACKAGE_PYTHON3_PY_PYC=y
BR2_PACKAGE_PYTHON3_BZIP2=y
BR2_PACKAGE_PYTHON_PSUTIL=y
BR2_PACKAGE_DNSMASQ=y
BR2_PACKAGE_NFTABLES=y
BR2_PACKAGE_NTP=y
BR2_PACKAGE_NTP_NTPDATE=y
BR2_PACKAGE_OPENRESOLV=y
BR2_PACKAGE_OPENSSH=y
BR2_PACKAGE_KMOD=y
BR2_PACKAGE_KMOD_TOOLS=y
BR2_PACKAGE_UTIL_LINUX_BINARIES=y
BR2_PACKAGE_UTIL_LINUX_PARTX=y
BR2_TARGET_ROOTFS_EXT2=y
BR2_TARGET_ROOTFS_EXT2_4=y
BR2_TARGET_ROOTFS_EXT2_SIZE="512M"
# BR2_TARGET_ROOTFS_TAR is not set
BR2_PACKAGE_HOST_GENIMAGE=y
BR2_PACKAGE_HOST_MTOOLS=y
BR2_PACKAGE_HOST_UBOOT_TOOLS=y
BR2_PACKAGE_HOST_UBOOT_TOOLS_FIT_SUPPORT=y
BR2_PACKAGE_HOST_DTC=y
BR2_PACKAGE_PYTHON_NOMADNET=y
BR2_PACKAGE_RNSBOX_PORTAL=y
BR2_PACKAGE_DBUS=y
BR2_PACKAGE_BLUEZ5_UTILS=y
BR2_PACKAGE_BLUEZ5_UTILS_CLIENT=y
BR2_PACKAGE_BLUEZ5_UTILS_TOOLS=y
BR2_PACKAGE_BLUEZ5_UTILS_DEPRECATED=y
BR2_PACKAGE_DBUS_PYTHON=y
BR2_PACKAGE_PYTHON_BLEAK=y
BR2_PACKAGE_PYTHON_DBUS_FAST=y
BR2_PACKAGE_RNSBOX_PYTHON_BLUEZERO=y
BR2_PACKAGE_PYTHON_BLE_RETICULUM=y
```

## configs/rnsbox_sg2000_duomodule01_mainline_defconfig
```kconfig
# RNSBox Milk-V Duo Module 01 EVB (Sophgo, C906 rv64gc) — MAINLINE 7.3 flow.
SD boot, internal EPHY Ethernet, eMMC on &emmc, AIC8800 SDIO1.

BR2_riscv=y
# rv64gc (C906; Bootlin toolchain + rust riscv64gc target require C)
BR2_RISCV_ISA_RVC=y
BR2_TOOLCHAIN_EXTERNAL=y
BR2_TOOLCHAIN_EXTERNAL_BOOTLIN_RISCV64_LP64D_GLIBC_STABLE=y
BR2_JLEVEL=3
BR2_TARGET_GENERIC_HOSTNAME="rnsbox"
BR2_TARGET_GENERIC_ISSUE="RNSBox - Reticulum router (Milk-V Duo Module 01 EVB, mainline)"
BR2_ROOTFS_DEVICE_TABLE="system/device_table_dev.txt system/device_table.txt"
BR2_TARGET_GENERIC_ROOT_PASSWD="admin"
# Shared SoC-independent RNSBox overlay first, SG2002-specific bits last
# (the later overlay wins: tuned fstab + zram/fstrim policy).
BR2_ROOTFS_OVERLAY="$(BR2_EXTERNAL_RNSBOX_PATH)/board/sg2000-mainline/rootfs-overlay"
BR2_ROOTFS_POST_BUILD_SCRIPT="$(BR2_EXTERNAL_RNSBOX_PATH)/board/common/slim-target.sh"
BR2_ROOTFS_POST_IMAGE_SCRIPT="$(BR2_EXTERNAL_RNSBOX_PATH)/board/sg2000-mainline/post-image.sh"
BR2_LINUX_KERNEL=y
BR2_LINUX_KERNEL_CUSTOM_GIT=y
BR2_LINUX_KERNEL_CUSTOM_REPO_URL="https://git.kernel.org/pub/scm/linux/kernel/git/stable/linux.git"
BR2_LINUX_KERNEL_CUSTOM_REPO_VERSION="v7.3-rc7"
BR2_LINUX_KERNEL_PATCH="$(BR2_EXTERNAL_RNSBOX_PATH)/board/sg2000-mainline/linux-patches"
BR2_LINUX_KERNEL_USE_CUSTOM_CONFIG=y
BR2_LINUX_KERNEL_CUSTOM_CONFIG_FILE="$(BR2_EXTERNAL_RNSBOX_PATH)/board/sg2000-mainline/linux.config"
BR2_LINUX_KERNEL_DTS_SUPPORT=y
BR2_LINUX_KERNEL_INTREE_DTS_NAME="sophgo/sg2000-duomodule01-evb"
BR2_LINUX_KERNEL_NEEDS_HOST_OPENSSL=y
BR2_PACKAGE_BUSYBOX_CONFIG_FRAGMENT_FILES="$(BR2_EXTERNAL_RNSBOX_PATH)/board/sg2000-mainline/busybox.fragment"
BR2_PACKAGE_BUSYBOX_SHOW_OTHERS=y
BR2_PACKAGE_XZ=y
BR2_PACKAGE_DOSFSTOOLS=y
BR2_PACKAGE_DOSFSTOOLS_FSCK_FAT=y
BR2_PACKAGE_DOSFSTOOLS_MKFS_FAT=y
BR2_PACKAGE_E2FSPROGS=y
BR2_PACKAGE_PYTHON3=y
BR2_PACKAGE_PYTHON3_PY_PYC=y
BR2_PACKAGE_PYTHON3_BZIP2=y
BR2_PACKAGE_PYTHON_PSUTIL=y
BR2_PACKAGE_DNSMASQ=y
BR2_PACKAGE_NFTABLES=y
BR2_PACKAGE_NTP=y
BR2_PACKAGE_NTP_NTPDATE=y
BR2_PACKAGE_OPENRESOLV=y
BR2_PACKAGE_OPENSSH=y
BR2_PACKAGE_KMOD=y
BR2_PACKAGE_KMOD_TOOLS=y
BR2_PACKAGE_UTIL_LINUX_BINARIES=y
BR2_PACKAGE_UTIL_LINUX_PARTX=y
BR2_TARGET_ROOTFS_EXT2=y
BR2_TARGET_ROOTFS_EXT2_4=y
BR2_TARGET_ROOTFS_EXT2_SIZE="512M"
# BR2_TARGET_ROOTFS_TAR is not set
BR2_PACKAGE_HOST_GENIMAGE=y
BR2_PACKAGE_HOST_MTOOLS=y
BR2_PACKAGE_HOST_UBOOT_TOOLS=y
BR2_PACKAGE_HOST_UBOOT_TOOLS_FIT_SUPPORT=y
BR2_PACKAGE_HOST_DTC=y
BR2_PACKAGE_PYTHON_NOMADNET=y
BR2_PACKAGE_RNSBOX_PORTAL=y
BR2_PACKAGE_DBUS=y
BR2_PACKAGE_BLUEZ5_UTILS=y
BR2_PACKAGE_BLUEZ5_UTILS_CLIENT=y
BR2_PACKAGE_BLUEZ5_UTILS_TOOLS=y
BR2_PACKAGE_BLUEZ5_UTILS_DEPRECATED=y
BR2_PACKAGE_DBUS_PYTHON=y
BR2_PACKAGE_PYTHON_BLEAK=y
BR2_PACKAGE_PYTHON_DBUS_FAST=y
BR2_PACKAGE_RNSBOX_PYTHON_BLUEZERO=y
BR2_PACKAGE_PYTHON_BLE_RETICULUM=y
# WiFi: the portal and S35wifi drive iw/wpa_supplicant/hostapd; the
# AIC8800D80 is a cfg80211 fullmac, so nl80211 is the only backend.
BR2_PACKAGE_IW=y
BR2_PACKAGE_WIRELESS_REGDB=y
BR2_PACKAGE_WPA_SUPPLICANT=y
BR2_PACKAGE_WPA_SUPPLICANT_NL80211=y
BR2_PACKAGE_WPA_SUPPLICANT_CLI=y
BR2_PACKAGE_WPA_SUPPLICANT_PASSPHRASE=y
BR2_PACKAGE_WPA_SUPPLICANT_WPA3=y
BR2_PACKAGE_HOSTAPD=y
BR2_PACKAGE_HOSTAPD_DRIVER_NL80211=y
BR2_PACKAGE_HOSTAPD_ACS=y
BR2_PACKAGE_HOSTAPD_WPA3=y

# TTY console: screen sessions + zsh, served by the portal itself.
BR2_PACKAGE_SCREEN=y
BR2_PACKAGE_ZSH=y
BR2_ROOTFS_USERS_TABLES="$(BR2_EXTERNAL_RNSBOX_PATH)/board/common/users.txt"
```

## package/aic8800-sdio-firmware/Config.in
```kconfig
config BR2_PACKAGE_AIC8800_SDIO_FIRMWARE
	bool "aic8800-sdio-firmware"
	help
	  AIC8800 SDIO WiFi/BT firmware blobs (plain 8800, 8800D80, DC and
	  D80X2 families). Installed to /usr/lib/firmware/aic8800_sdio/,
	  the path the aic8800_bsp driver compiles in as CONFIG_AIC_FW_PATH.

	  Selected automatically by BR2_PACKAGE_AIC8800; the SG2000/SG2002
	  image only needs the aic8800_and_aic8800D80 family, and
	  board/common/slim-target.sh drops the other two after install.
```
