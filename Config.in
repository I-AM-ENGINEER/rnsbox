## Config.in
```kconfig
menu "RNSBox packages"
source "$BR2_EXTERNAL_RNSBOX_PATH/package/python-lxmf/Config.in"
source "$BR2_EXTERNAL_RNSBOX_PATH/package/python-nomadnet/Config.in"
source "$BR2_EXTERNAL_RNSBOX_PATH/package/python-rns/Config.in"
source "$BR2_EXTERNAL_RNSBOX_PATH/package/python-rns-time/Config.in"
source "$BR2_EXTERNAL_RNSBOX_PATH/package/python-cryptography-legacy/Config.in"
source "$BR2_EXTERNAL_RNSBOX_PATH/package/rnsbox-portal/Config.in"
source "$BR2_EXTERNAL_RNSBOX_PATH/package/python-ble-reticulum/Config.in"
source "$BR2_EXTERNAL_RNSBOX_PATH/package/rnsbox-python-bluezero/Config.in"
source "$BR2_EXTERNAL_RNSBOX_PATH/package/rnsbox-bt-firmware/Config.in"
source "$BR2_EXTERNAL_RNSBOX_PATH/package/rnsbox-update/Config.in"
source "$BR2_EXTERNAL_RNSBOX_PATH/package/aic8800/Config.in"
source "$BR2_EXTERNAL_RNSBOX_PATH/package/aic8800-sdio-firmware/Config.in"
source "$BR2_EXTERNAL_RNSBOX_PATH/package/morse-driver/Config.in"
source "$BR2_EXTERNAL_RNSBOX_PATH/package/mt7628-esw/Config.in"
source "$BR2_EXTERNAL_RNSBOX_PATH/package/ht-hd01-firmware/Config.in"
endmenu
```

## board/milkv-duo/boot.its
```
/*
 * RNSBox mainline boot.sd FIT for the vendor u-boot (milkv-duo-cv1800b flow
 * blobs, see README.fip.md). Packed by post-image.sh with cwd = BINARIES_DIR
 * (the /incbin/ paths are relative to it).
 *
 * - config name is NOT free: the vendor u-boot runs
 *   `bootm ${uImage_addr}#config-cv1800b_sophpi_duo_sd`.
 * - load/entry 0x80200000: mainline riscv needs a 2MB-aligned load address;
 *   0x80200000 is clear of the OpenSBI region (0x80000000..0x80080000,
 *   reserved in the DTS) and of the FAT-load buffer at 0x81400000 (u-boot
 *   has already relocated itself to the top of RAM by bootm time).
 * - gzip: u-boot unpacks it (vendor flow ships Image.gz the same way);
 *   the gzipped mini-config Image comfortably fits the 15M FAT-load buffer.
 * - crc32 hashes: exactly what the vendor FIT uses (u-boot 2021.10 cvitek).
 */
/dts-v1/;

/ {
	description = "RNSBox mainline (milkv-duo cv1800b)";
	#address-cells = <2>;

	images {
		kernel-1 {
			description = "mainline linux Image.gz";
			data = /incbin/("./Image.gz");
			type = "kernel";
			arch = "riscv";
			os = "linux";
			compression = "gzip";
			load = <0x0 0x80200000>;
			entry = <0x0 0x80200000>;
			hash-1 {
				algo = "crc32";
			};
		};

		fdt-cv1800b_sophpi_duo_sd {
			description = "mainline cv1800b-milkv-duo device tree";
			data = /incbin/("./cv1800b-milkv-duo.dtb");
			type = "flat_dt";
			arch = "riscv";
			compression = "none";
			hash-1 {
				algo = "crc32";
			};
		};
	};

	configurations {
		default = "config-cv1800b_sophpi_duo_sd";
		config-cv1800b_sophpi_duo_sd {
			description = "RNSBox mainline cv1800b (vendor u-boot name)";
			kernel = "kernel-1";
			fdt = "fdt-cv1800b_sophpi_duo_sd";
		};
	};
};
```

## board/sg2000-duo-s-mainline/boot.its
```
/*
 * RNSBox mainline boot.sd FIT for the Milk-V Duo S (SG2000, C906).
 * Same scheme as board/sg2000-mainline/boot.its: the vendor u-boot boots
 * the FIT's default configuration (older generations append
 * #config-sg2000_duo_sd), Image.gz is gunzipped to 0x80200000.
 *
 * Built by configs/rnsbox_duo_s_mainline_defconfig; the mainline
 * v7.3-rc7 tree already ships sg2000-milkv-duo-s.dts and
 * linux-patches/0001-* enables its gmac0 + mdio nodes (internal EPHY).
 */
/dts-v1/;

/ {
	description = "RNSBox mainline (sg2000 milkv-duo-s)";
	#address-cells = <2>;

	images {
		kernel-1 {
			description = "mainline linux Image.gz";
			data = /incbin/("./Image.gz");
			type = "kernel";
			arch = "riscv";
			os = "linux";
			compression = "gzip";
			load = <0x0 0x80200000>;
			entry = <0x0 0x80200000>;
			hash-1 {
				algo = "crc32";
			};
		};

		fdt-sg2000_duo_sd {
			description = "mainline sg2000-milkv-duo-s device tree";
			data = /incbin/("./sg2000-milkv-duo-s.dtb");
			type = "flat_dt";
			arch = "riscv";
			compression = "none";
			hash-1 {
				algo = "crc32";
			};
		};
	};

	configurations {
		default = "config-sg2000_duo_sd";
		config-sg2000_duo_sd {
			description = "RNSBox mainline sg2000 (vendor u-boot name)";
			kernel = "kernel-1";
			fdt = "fdt-sg2000_duo_sd";
		};
	};
};
```

## board/sg2000-duo-s/boot.its
```
/*
 * RNSBox boot.sd FIT for the Milk-V Duo S (SG2000, C906).
 * Same scheme as board/sg2000/boot.its: the vendor u-boot boots
 * the FIT's default configuration (older generations append
 * #config-sg2000_duo_sd), Image.gz is gunzipped to 0x80200000.
 *
 * Built by configs/rnsbox_duo_s_defconfig; the
 * v7.3-rc7 tree already ships sg2000-milkv-duo-s.dts and
 * linux-patches/0001-* enables its gmac0 + mdio nodes (internal EPHY).
 */
/dts-v1/;

/ {
	description = "RNSBox (sg2000 milkv-duo-s)";
	#address-cells = <2>;

	images {
		kernel-1 {
			description = "linux Image.gz";
			data = /incbin/("./Image.gz");
			type = "kernel";
			arch = "riscv";
			os = "linux";
			compression = "gzip";
			load = <0x0 0x80200000>;
			entry = <0x0 0x80200000>;
			hash-1 {
				algo = "crc32";
			};
		};

		fdt-sg2000_duo_sd {
			description = "sg2000-milkv-duo-s device tree";
			data = /incbin/("./sg2000-milkv-duo-s.dtb");
			type = "flat_dt";
			arch = "riscv";
			compression = "none";
			hash-1 {
				algo = "crc32";
			};
		};
	};

	configurations {
		default = "config-sg2000_duo_sd";
		config-sg2000_duo_sd {
			description = "RNSBox sg2000 (vendor u-boot name)";
			kernel = "kernel-1";
			fdt = "fdt-sg2000_duo_sd";
		};
	};
};
```

## board/sg2000-duomodule01-arm64/boot.its
```
/*
 * RNSBox boot.sd FIT for the Milk-V Duo Module 01 EVB (SG2000, Cortex-A53).
 * Same scheme as board/sg2000-duo-s-arm64/boot.its: the vendor u-boot boots
 * the FIT's default configuration, Image is loaded at 0x80200000.
 *
 * The vendor u-boot blob is the ARM64 one from the SG2000 vendor BSP
 * (sg2000_duo01evb_arm64_sd — the Duo Module 01 EVB; identical blob and
 * provenance as board/sg2000-duo-s-arm64/fip.bin).  It names its boot
 * config after the board directory, so the default and the named config
 * both use that name.
 */
/dts-v1/;

/ {
	description = "RNSBox (sg2000 duomodule01 arm64)";
	#address-cells = <2>;

	images {
		kernel-1 {
			description = "linux arm64 Image";
			data = /incbin/("./Image");
			type = "kernel";
			arch = "arm64";
			os = "linux";
			compression = "none";
			load = <0x0 0x80200000>;
			entry = <0x0 0x80200000>;
			hash-1 {
				algo = "crc32";
			};
		};

		fdt-sg2000_duo01evb_arm64_sd {
			description = "sg2000-milkv-duo-module-01-evb device tree";
			data = /incbin/("./sg2000-milkv-duo-module-01-evb.dtb");
			type = "flat_dt";
			arch = "arm64";
			compression = "none";
			hash-1 {
				algo = "crc32";
			};
		};
	};

	configurations {
		default = "config-sg2000_duo01evb_arm64_sd";
		config-sg2000_duo01evb_arm64_sd {
			description = "RNSBox sg2000 arm64 (vendor u-boot name)";
			kernel = "kernel-1";
			fdt = "fdt-sg2000_duo01evb_arm64_sd";
		};
	};
};
```

## board/sg2000-mainline/boot.its
```
/*
 * RNSBox mainline boot.sd FIT for the vendor u-boot (sg2000-duomodule01 flow
 * blobs, see README.fip.md). Packed by post-image.sh with cwd = BINARIES_DIR
 * (the /incbin/ paths are relative to it).
 *
 * - the vendor sg2000 u-boot ends its sdboot env with a BARE
 *   `bootm ${uImage_addr}` (no #config suffix; CVICHIP is not defined in
 *   this SDK build), so u-boot 2021.10 without CONFIG_MULTI_DTB_FIT
 *   resolves the configuration only through the `default` property of
 *   /configurations — it MUST be present (same lesson as the cv1800b
 *   flow; see main commits f278299 + 5e9c52c).
 * - load/entry 0x80200000: mainline riscv needs a 2MB-aligned load
 *   address; 0x80200000 is clear of the OpenSBI region
 *   (0x80000000..0x80080000, reserved in the DTS) and of the FIT-load
 *   buffer at 0x81800000 (u-boot fatloads boot.sd there and has already
 *   relocated itself to the top of RAM by bootm time).
 * - gzip: u-boot unpacks it (the vendor flow ships Image.gz the same
 *   way); the gzipped mini-config Image comfortably fits the 16 MB
 *   UIMAG fatload buffer.
 * - crc32 hashes: exactly what the vendor FIT uses (u-boot 2021.10 cvitek).
 */
/dts-v1/;

/ {
	description = "RNSBox mainline (sg2000 duomodule01)";
	#address-cells = <2>;

	images {
		kernel-1 {
			description = "mainline linux Image.gz";
			data = /incbin/("./Image.gz");
			type = "kernel";
			arch = "riscv";
			os = "linux";
			compression = "gzip";
			load = <0x0 0x80200000>;
			entry = <0x0 0x80200000>;
			hash-1 {
				algo = "crc32";
			};
		};

		fdt-sg2000_duomodule01_sd {
			description = "mainline sg2000-duomodule01-evb device tree";
			data = /incbin/("./sg2000-duomodule01-evb.dtb");
			type = "flat_dt";
			arch = "riscv";
			compression = "none";
			hash-1 {
				algo = "crc32";
			};
		};
	};

	configurations {
		default = "config-sg2000_duomodule01_sd";
		config-sg2000_duomodule01_sd {
			description = "RNSBox mainline sg2000 (vendor u-boot name)";
			kernel = "kernel-1";
			fdt = "fdt-sg2000_duomodule01_sd";
		};
	};
};
```

## board/sg2000/boot.its
```
/*
 * RNSBox boot.sd FIT for the vendor u-boot (sg2000-duomodule01
 * flow blobs, see README.fip.md). Packed by post-image.sh with cwd =
 * BINARIES_DIR (the /incbin/ paths are relative to it).
 *
 * - config name follows the older vendor u-boot env (older sg2000 fip
 *   generations run `bootm ${uImage_addr}#config-sg2000_duomodule01_sd`);
 *   the current flow u-boot (patch 0034, plain `bootm`) boots the FIT's
 *   DEFAULT configuration — which is this one, so the same boot.sd boots
 *   under both u-boot generations.
 * - load/entry 0x80200000: riscv needs a 2MB-aligned load
 *   address; 0x80200000 is clear of the OpenSBI region (0x80000000..
 *   0x80080000, reserved in the DTS) and of the FAT-load buffer at
 *   0x81800000 (u-boot has already relocated itself to the top of RAM by
 *   bootm time).
 * - gzip: u-boot unpacks it (the vendor flow ships Image.gz the same
 *   way); the gzipped mini-config Image comfortably fits the 16M
 *   FAT-load buffer region.
 * - crc32 hashes: exactly what the vendor FIT uses (u-boot 2021.10
 *   cvitek).
 */
/dts-v1/;

/ {
	description = "RNSBox (sg2000 milkv-duo-module-01 EVB)";
	#address-cells = <2>;

	images {
		kernel-1 {
			description = "linux Image.gz";
			data = /incbin/("./Image.gz");
			type = "kernel";
			arch = "riscv";
			os = "linux";
			compression = "gzip";
			load = <0x0 0x80200000>;
			entry = <0x0 0x80200000>;
			hash-1 {
				algo = "crc32";
			};
		};

		fdt-sg2000_duomodule01_sd {
			description = "sg2000-milkv-duomodule01-evb device tree";
			data = /incbin/("./sg2000-duomodule01-evb.dtb");
			type = "flat_dt";
			arch = "riscv";
			compression = "none";
			hash-1 {
				algo = "crc32";
			};
		};
	};

	configurations {
		default = "config-sg2000_duomodule01_sd";
		config-sg2000_duomodule01_sd {
			description = "RNSBox sg2000 (vendor u-boot name)";
			kernel = "kernel-1";
			fdt = "fdt-sg2000_duomodule01_sd";
		};
	};
};
```

## board/sg2002-duo256m-mainline/boot.its
```
/*
 * RNSBox mainline boot.sd FIT for the Milk-V Duo 256M (SG2002, C906).
 * Same scheme as board/sg2000-mainline/boot.its: the vendor u-boot boots
 * the FIT's default configuration (older generations append
 * #config-sg2002_duo_sd), Image.gz is gunzipped to 0x80200000.
 *
 * Built by configs/rnsbox_duo256m_mainline_defconfig; the mainline
 * v7.3-rc7 tree already ships sg2002-milkv-duo256m.dts and
 * linux-patches/0001-* enables its gmac0 + mdio nodes (internal EPHY).
 */
/dts-v1/;

/ {
	description = "RNSBox mainline (sg2002 milkv-duo256m)";
	#address-cells = <2>;

	images {
		kernel-1 {
			description = "mainline linux Image.gz";
			data = /incbin/("./Image.gz");
			type = "kernel";
			arch = "riscv";
			os = "linux";
			compression = "gzip";
			load = <0x0 0x80200000>;
			entry = <0x0 0x80200000>;
			hash-1 {
				algo = "crc32";
			};
		};

		fdt-sg2002_duo_sd {
			description = "mainline sg2002-milkv-duo256m device tree";
			data = /incbin/("./sg2002-milkv-duo256m.dtb");
			type = "flat_dt";
			arch = "riscv";
			compression = "none";
			hash-1 {
				algo = "crc32";
			};
		};
	};

	configurations {
		default = "config-sg2002_duo_sd";
		config-sg2002_duo_sd {
			description = "RNSBox mainline sg2002 duo256m (vendor u-boot name)";
			kernel = "kernel-1";
			fdt = "fdt-sg2002_duo_sd";
		};
	};
};
```

## board/sg2002-duo256m/boot.its
```
/*
 * RNSBox boot.sd FIT for the Milk-V Duo 256M (SG2002, C906).
 * Same scheme as board/sg2000/boot.its: the vendor u-boot boots
 * the FIT's default configuration (older generations append
 * #config-sg2002_duo_sd), Image.gz is gunzipped to 0x80200000.
 *
 * Built by configs/rnsbox_duo256m_defconfig; the
 * v7.3-rc7 tree already ships sg2002-milkv-duo256m.dts and
 * linux-patches/0001-* enables its gmac0 + mdio nodes (internal EPHY).
 */
/dts-v1/;

/ {
	description = "RNSBox (sg2002 milkv-duo256m)";
	#address-cells = <2>;

	images {
		kernel-1 {
			description = "linux Image.gz";
			data = /incbin/("./Image.gz");
			type = "kernel";
			arch = "riscv";
			os = "linux";
			compression = "gzip";
			load = <0x0 0x80200000>;
			entry = <0x0 0x80200000>;
			hash-1 {
				algo = "crc32";
			};
		};

		fdt-sg2002_duo_sd {
			description = "sg2002-milkv-duo256m device tree";
			data = /incbin/("./sg2002-milkv-duo256m.dtb");
			type = "flat_dt";
			arch = "riscv";
			compression = "none";
			hash-1 {
				algo = "crc32";
			};
		};
	};

	configurations {
		default = "config-sg2002_duo_sd";
		config-sg2002_duo_sd {
			description = "RNSBox sg2002 duo256m (vendor u-boot name)";
			kernel = "kernel-1";
			fdt = "fdt-sg2002_duo_sd";
		};
	};
};
```

## board/sg2002-licheerv-nano-arm64/boot.its
```
/*
 * RNSBox boot.sd FIT for the LicheeRV Nano B (SG2002, Cortex-A53).
 * Same scheme as board/sg2000-duomodule01-arm64/boot.its: the vendor
 * ARM64 u-boot boots the FIT's default configuration, Image is loaded at
 * 0x80200000.
 *
 * The vendor u-boot blob is the A53 one from the Sipeed LicheeRV-Nano-Build
 * release image (2024-03-26, board sg2002_licheea53nano_sd; sha256 in
 * fip.bin.sha256). It names its boot config after the board directory, so
 * the default and the named config both use that name.
 */
/dts-v1/;

/ {
	description = "RNSBox (sg2002 licheerv-nano arm64)";
	#address-cells = <2>;

	images {
		kernel-1 {
			description = "linux arm64 Image";
			data = /incbin/("./Image");
			type = "kernel";
			arch = "arm64";
			os = "linux";
			compression = "none";
			load = <0x0 0x80200000>;
			entry = <0x0 0x80200000>;
			hash-1 {
				algo = "crc32";
			};
		};

		fdt-sg2002_licheea53nano_sd {
			description = "sg2002-licheerv-nano-b device tree";
			data = /incbin/("./sg2002-licheerv-nano-b.dtb");
			type = "flat_dt";
			arch = "arm64";
			compression = "none";
			hash-1 {
				algo = "crc32";
			};
		};
	};

	configurations {
		default = "config-sg2002_licheea53nano_sd";
		config-sg2002_licheea53nano_sd {
			description = "RNSBox sg2002 arm64 (vendor u-boot name)";
			kernel = "kernel-1";
			fdt = "fdt-sg2002_licheea53nano_sd";
		};
	};
};
```
